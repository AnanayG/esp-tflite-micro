## examples/person_detection/main/Kconfig.projbuild
```kconfig
menu  "Application Configuration"

config TFLITE_USE_BSP
    bool
    default n

choice BSP_SUPPORT
    bool "Select BSP"
    default TFLITE_USE_BSP_NONE
    help
       Select Board Support Package for your Board.
       Make sure you select the correct target with idf.py set-target
       BEFORE you set the BSP.

    config TFLITE_USE_BSP_S3_EYE
        bool "ESP32-S3-EYE"
        select TFLITE_USE_BSP
    config TFLITE_USE_BSP_KORVO_2
        bool "ESP32-S3-KORVO-2"
        select TFLITE_USE_BSP
    config TFLITE_USE_BSP_KALUGA
        bool "ESP32-S2-KALUGA-KIT"
        select TFLITE_USE_BSP
    config TFLITE_USE_BSP_NONE
        bool "None"
endchoice

menu "Camera Configuration"
depends on !TFLITE_USE_BSP
choice CAMERA_MODULE
    bool "Select Camera Pinout"
    default CAMERA_MODULE_WROVER_KIT
    help
        Select Camera Pinout.

    config CAMERA_MODULE_WROVER_KIT
        bool "WROVER-KIT With OV2640 Module"
    config CAMERA_MODULE_ESP_EYE
        bool "ESP-EYE DevKit"
    config CAMERA_MODULE_ESP_S2_KALUGA
        bool "ESP32-S2-Kaluga-1 V1.3"
    config CAMERA_MODULE_ESP_S3_EYE
        bool "ESP-S3-EYE DevKit"
    config CAMERA_MODULE_ESP32_CAM_BOARD
        bool "ESP32 Camera Development Board"
    config CAMERA_MODULE_M5STACK_PSRAM
        bool "M5Stack Camera With PSRAM"
    config CAMERA_MODULE_M5STACK_WIDE
        bool "M5Stack Camera F (Wide)"
    config CAMERA_MODULE_AI_THINKER
        bool "ESP32-CAM by AI-Thinker"
    config CAMERA_MODULE_XIAO_ESP32S3
        bool "XIAO-ESP32S3 by SEEED Studio"
    config CAMERA_MODULE_CUSTOM
        bool "Custom Camera Pinout"
endchoice

config CAMERA_PIN_PWDN
    depends on CAMERA_MODULE_CUSTOM
    int "Power Down pin"
    range -1 33
    default -1
    help
        Select Power Down pin or -1 for unmanaged.

config CAMERA_PIN_RESET
    depends on CAMERA_MODULE_CUSTOM
    int "Reset pin"
    range -1 33
    default -1
    help
        Select Camera Reset pin or -1 for software reset.

config CAMERA_PIN_XCLK
    depends on CAMERA_MODULE_CUSTOM
    int "XCLK pin"
    range 0 33
    default 21
    help
        Select Camera XCLK pin.

config CAMERA_PIN_SIOD
    depends on CAMERA_MODULE_CUSTOM
    int "SIOD pin"
    range 0 33
    default 26
    help
        Select Camera SIOD pin.

config CAMERA_PIN_SIOC
    depends on CAMERA_MODULE_CUSTOM
    int "SIOC pin"
    range 0 33
    default 27
    help
        Select Camera SIOC pin.

config CAMERA_PIN_VSYNC
    depends on CAMERA_MODULE_CUSTOM
    int "VSYNC pin"
    range 0 39
    default 25
    help
        Select Camera VSYNC pin.

config CAMERA_PIN_HREF
    depends on CAMERA_MODULE_CUSTOM
    int "HREF pin"
    range 0 39
    default 23
    help
        Select Camera HREF pin.

config CAMERA_PIN_PCLK
    depends on CAMERA_MODULE_CUSTOM
    int "PCLK pin"
    range 0 39
    default 25
    help
        Select Camera PCLK pin.

config CAMERA_PIN_Y2
    depends on CAMERA_MODULE_CUSTOM
    int "Y2 pin"
    range 0 39
    default 4
    help
        Select Camera Y2 pin.

config CAMERA_PIN_Y3
    depends on CAMERA_MODULE_CUSTOM
    int "Y3 pin"
    range 0 39
    default 5
    help
        Select Camera Y3 pin.

config CAMERA_PIN_Y4
    depends on CAMERA_MODULE_CUSTOM
    int "Y4 pin"
    range 0 39
    default 18
    help
        Select Camera Y4 pin.

config CAMERA_PIN_Y5
    depends on CAMERA_MODULE_CUSTOM
    int "Y5 pin"
    range 0 39
    default 19
    help
        Select Camera Y5 pin.

config CAMERA_PIN_Y6
    depends on CAMERA_MODULE_CUSTOM
    int "Y6 pin"
    range 0 39
    default 36
    help
        Select Camera Y6 pin.

config CAMERA_PIN_Y7
    depends on CAMERA_MODULE_CUSTOM
    int "Y7 pin"
    range 0 39
    default 39
    help
        Select Camera Y7 pin.

config CAMERA_PIN_Y8
    depends on CAMERA_MODULE_CUSTOM
    int "Y8 pin"
    range 0 39
    default 34
    help
        Select Camera Y8 pin.

config CAMERA_PIN_Y9
    depends on CAMERA_MODULE_CUSTOM
    int "Y9 pin"
    range 0 39
    default 35
    help
        Select Camera Y9 pin.
endmenu

menu "Deep Sleep Wakeup Configuration"
choice DEEP_SLEEP_WAKEUP_MODE
    bool "Select wakeup mode"
    default EXAMPLE_EXT0_WAKEUP
    config EXAMPLE_EXT0_WAKEUP
        bool "Enable wakeup from GPIO (ext0)"
        default y if !IDF_TARGET_ESP32
        default n if IDF_TARGET_ESP32
        depends on SOC_PM_SUPPORT_EXT0_WAKEUP
        help
            This option enables wake up from deep sleep from a GPIO pin. It should be connected to LOW to
            avoid floating pins. When triggering a wake up, connect the pin to HIGH. Note a floating pin
            may trigger a wake up.

            Note: On ESP32, ext0 wakeup source can not be used together with touch wakeup source.

    menu "EXT0 wakeup configuration"
        visible if EXAMPLE_EXT0_WAKEUP

        config EXAMPLE_EXT0_WAKEUP_PIN
            int "Enable wakeup from PIN"
            depends on !IDF_TARGET_ESP32
            default 2 if !IDF_TARGET_ESP32H2
            default 10 if IDF_TARGET_ESP32H2
            range 0 7 if IDF_TARGET_ESP32C6
            range 7 14 if IDF_TARGET_ESP32H2
            range 0 21 if IDF_TARGET_ESP32S2
            range 0 21 if IDF_TARGET_ESP32S3

        choice EXAMPLE_EXT0_WAKEUP_PIN_SEL
            prompt "Enable wakeup from PIN"
            default EXAMPLE_EXT0_WAKEUP_PIN_SEL_2
            depends on IDF_TARGET_ESP32
            config EXAMPLE_EXT0_WAKEUP_PIN_SEL_0
                bool "GPIO 0"
            config EXAMPLE_EXT0_WAKEUP_PIN_SEL_2
                bool "GPIO 2"
            config EXAMPLE_EXT0_WAKEUP_PIN_SEL_4
                bool "GPIO 4"
            config EXAMPLE_EXT0_WAKEUP_PIN_SEL_12
                bool "GPIO 12"
            config EXAMPLE_EXT0_WAKEUP_PIN_SEL_13
                bool "GPIO 13"
            config EXAMPLE_EXT0_WAKEUP_PIN_SEL_14
                bool "GPIO 14"
            config EXAMPLE_EXT0_WAKEUP_PIN_SEL_15
                bool "GPIO 15"
            config EXAMPLE_EXT0_WAKEUP_PIN_SEL_25
                bool "GPIO 25"
            config EXAMPLE_EXT0_WAKEUP_PIN_SEL_26
                bool "GPIO 26"
            config EXAMPLE_EXT0_WAKEUP_PIN_SEL_27
                bool "GPIO 27"
            config EXAMPLE_EXT0_WAKEUP_PIN_SEL_32
                bool "GPIO 32"
            config EXAMPLE_EXT0_WAKEUP_PIN_SEL_33
                bool "GPIO 33"
            config EXAMPLE_EXT0_WAKEUP_PIN_SEL_34
                bool "GPIO 34"
            config EXAMPLE_EXT0_WAKEUP_PIN_SEL_35
                bool "GPIO 35"
            config EXAMPLE_EXT0_WAKEUP_PIN_SEL_36
                bool "GPIO 36"
            config EXAMPLE_EXT0_WAKEUP_PIN_SEL_37
                bool "GPIO 37"
            config EXAMPLE_EXT0_WAKEUP_PIN_SEL_38
                bool "GPIO 38"
            config EXAMPLE_EXT0_WAKEUP_PIN_SEL_39
                bool "GPIO 39"
        endchoice

        config EXAMPLE_EXT0_WAKEUP_PIN
            int
            depends on IDF_TARGET_ESP32
            default 0  if EXAMPLE_EXT0_WAKEUP_PIN_SEL_0
            default 2  if EXAMPLE_EXT0_WAKEUP_PIN_SEL_2
            default 4  if EXAMPLE_EXT0_WAKEUP_PIN_SEL_4
            default 12 if EXAMPLE_EXT0_WAKEUP_PIN_SEL_12
            default 13 if EXAMPLE_EXT0_WAKEUP_PIN_SEL_13
            default 14 if EXAMPLE_EXT0_WAKEUP_PIN_SEL_14
            default 15 if EXAMPLE_EXT0_WAKEUP_PIN_SEL_15
            default 25 if EXAMPLE_EXT0_WAKEUP_PIN_SEL_25
            default 26 if EXAMPLE_EXT0_WAKEUP_PIN_SEL_26
            default 27 if EXAMPLE_EXT0_WAKEUP_PIN_SEL_27
            default 32 if EXAMPLE_EXT0_WAKEUP_PIN_SEL_32
            default 33 if EXAMPLE_EXT0_WAKEUP_PIN_SEL_33
            default 34 if EXAMPLE_EXT0_WAKEUP_PIN_SEL_34
            default 35 if EXAMPLE_EXT0_WAKEUP_PIN_SEL_35
            default 36 if EXAMPLE_EXT0_WAKEUP_PIN_SEL_36
            default 37 if EXAMPLE_EXT0_WAKEUP_PIN_SEL_37
            default 38 if EXAMPLE_EXT0_WAKEUP_PIN_SEL_38
            default 39 if EXAMPLE_EXT0_WAKEUP_PIN_SEL_39
    endmenu

    config EXAMPLE_EXT1_WAKEUP
        bool "Enable wakeup from GPIO (ext1)"
        default y
        depends on SOC_PM_SUPPORT_EXT1_WAKEUP
        help
            This option enables wake up from deep sleep from a GPIO pin. It should be connected to LOW to
            avoid floating pins. When triggering a wake up, connect the pin to HIGH. Note a floating pin
            may trigger a wake up.

    menu "EXT1 wakeup configuration"
        visible if EXAMPLE_EXT1_WAKEUP

        config EXAMPLE_EXT1_WAKEUP_PIN
            int "Enable wakeup from PIN"
            depends on !IDF_TARGET_ESP32
            default 2 if !IDF_TARGET_ESP32H2
            default 10 if IDF_TARGET_ESP32H2
            range 0 7 if IDF_TARGET_ESP32C6
            range 7 14 if IDF_TARGET_ESP32H2
            range 0 21 if IDF_TARGET_ESP32S2
            range 0 21 if IDF_TARGET_ESP32S3

        choice EXAMPLE_EXT1_WAKEUP_PIN_SEL
            prompt "Enable wakeup from PIN"
            default EXAMPLE_EXT1_WAKEUP_PIN_SEL_2
            depends on IDF_TARGET_ESP32
            config EXAMPLE_EXT1_WAKEUP_PIN_SEL_0
                bool "GPIO 0"
            config EXAMPLE_EXT1_WAKEUP_PIN_SEL_2
                bool "GPIO 2"
            config EXAMPLE_EXT1_WAKEUP_PIN_SEL_4
                bool "GPIO 4"
            config EXAMPLE_EXT1_WAKEUP_PIN_SEL_12
                bool "GPIO 12"
            config EXAMPLE_EXT1_WAKEUP_PIN_SEL_13
                bool "GPIO 13"
            config EXAMPLE_EXT1_WAKEUP_PIN_SEL_14
                bool "GPIO 14"
            config EXAMPLE_EXT1_WAKEUP_PIN_SEL_15
                bool "GPIO 15"
            config EXAMPLE_EXT1_WAKEUP_PIN_SEL_25
                bool "GPIO 25"
            config EXAMPLE_EXT1_WAKEUP_PIN_SEL_26
                bool "GPIO 26"
            config EXAMPLE_EXT1_WAKEUP_PIN_SEL_27
                bool "GPIO 27"
            config EXAMPLE_EXT1_WAKEUP_PIN_SEL_32
                bool "GPIO 32"
            config EXAMPLE_EXT1_WAKEUP_PIN_SEL_33
                bool "GPIO 33"
            config EXAMPLE_EXT1_WAKEUP_PIN_SEL_34
                bool "GPIO 34"
            config EXAMPLE_EXT1_WAKEUP_PIN_SEL_35
                bool "GPIO 35"
            config EXAMPLE_EXT1_WAKEUP_PIN_SEL_36
                bool "GPIO 36"
            config EXAMPLE_EXT1_WAKEUP_PIN_SEL_37
                bool "GPIO 37"
            config EXAMPLE_EXT1_WAKEUP_PIN_SEL_38
                bool "GPIO 38"
            config EXAMPLE_EXT1_WAKEUP_PIN_SEL_39
                bool "GPIO 39"
        endchoice

        config EXAMPLE_EXT1_WAKEUP_PIN
            int
            depends on IDF_TARGET_ESP32
            default 0 if EXAMPLE_EXT1_WAKEUP_PIN_SEL_0
            default 2 if EXAMPLE_EXT1_WAKEUP_PIN_SEL_2
            default 4 if EXAMPLE_EXT1_WAKEUP_PIN_SEL_4
            default 12 if EXAMPLE_EXT1_WAKEUP_PIN_SEL_12
            default 13 if EXAMPLE_EXT1_WAKEUP_PIN_SEL_13
            default 14 if EXAMPLE_EXT1_WAKEUP_PIN_SEL_14
            default 15 if EXAMPLE_EXT1_WAKEUP_PIN_SEL_15
            default 25 if EXAMPLE_EXT1_WAKEUP_PIN_SEL_25
            default 26 if EXAMPLE_EXT1_WAKEUP_PIN_SEL_26
            default 27 if EXAMPLE_EXT1_WAKEUP_PIN_SEL_27
            default 32 if EXAMPLE_EXT1_WAKEUP_PIN_SEL_32
            default 33 if EXAMPLE_EXT1_WAKEUP_PIN_SEL_33
            default 34 if EXAMPLE_EXT1_WAKEUP_PIN_SEL_34
            default 35 if EXAMPLE_EXT1_WAKEUP_PIN_SEL_35
            default 36 if EXAMPLE_EXT1_WAKEUP_PIN_SEL_36
            default 37 if EXAMPLE_EXT1_WAKEUP_PIN_SEL_37
            default 38 if EXAMPLE_EXT1_WAKEUP_PIN_SEL_38
            default 39 if EXAMPLE_EXT1_WAKEUP_PIN_SEL_39

        choice EXAMPLE_EXT1_WAKEUP_MODE_SEL
            prompt "Select wakeup mode from EXT1"
            default ESP_EXT1_WAKEUP_ANY_HIGH
            config ESP_EXT1_WAKEUP_ANY_LOW
                bool "GPIO any low level"
                depends on !IDF_TARGET_ESP32
            config ESP_EXT1_WAKEUP_ALL_LOW
                bool "GPIO all low level"
                depends on IDF_TARGET_ESP32
            config ESP_EXT1_WAKEUP_ANY_HIGH
                bool "GPIO any high level"
        endchoice

        config EXAMPLE_EXT1_WAKEUP_MODE
            int
            default 0 if ESP_EXT1_WAKEUP_ANY_LOW
            default 0 if ESP_EXT1_WAKEUP_ALL_LOW
            default 1 if ESP_EXT1_WAKEUP_ANY_HIGH

        config EXAMPLE_EXT1_USE_INTERNAL_PULLUPS
            bool "Use internal pull-up/downs for EXT1 wakeup source"
            default n
            depends on EXAMPLE_EXT1_WAKEUP
            help
                When using EXT1 wakeup source without external pull-up/downs, you may want to make use of
                the internal ones.

                if we turn off the RTC_PERIPH domain or if certain chips lack the RTC_PERIPH domain,
                we will use the HOLD feature to maintain the pull-up and pull-down on the pins during sleep.
                but if we turn on the RTC_PERIPH domain, we don not need to use HOLD feature and this will
                increase some power comsumption.

                EXT0 wakeup source resides in the same power domain as RTCIO (RTC Periph), so internal
                pull-up/downs are always available. There's no need to explicitly force it on for EXT0.
    endmenu

    config EXAMPLE_GPIO_WAKEUP
        bool "Enable wakeup from GPIO"
        default y
        depends on SOC_GPIO_SUPPORT_DEEPSLEEP_WAKEUP
        help
            This option enables wake up from GPIO. Be aware that if you use low level to trigger wakeup, we strongly
            recommand you to connect external pull-up resistance.

    menu "GPIO wakeup configuration"
        visible if EXAMPLE_GPIO_WAKEUP

        config EXAMPLE_GPIO_WAKEUP_PIN
            int "Enable wakeup from GPIO"
            default 0
            range 0 7 if IDF_TARGET_ESP32C6
            range 0 5 if !IDF_TARGET_ESP32C6

        config EXAMPLE_GPIO_WAKEUP_HIGH_LEVEL
            bool "Enable GPIO high-level wakeup"
            default y
            help
                This option set the gpio wake-up trigger signal, In deep sleep, only high or low level wake-up is
                supported. If this option is enabled, it is a high level wake up, otherwise it is a low level wake up.
    endmenu
endchoice
endmenu

endmenu
menu "Wifi Configuration"

config EXAMPLE_BASIC_AUTH
    bool "Basic Authentication"
    default n
    help
        Basic Authentication is a method for an HTTP user agent (e.g. a web browser)
        to provide a user name and password when making a request. It is the simplest
        technique for enforcing access controls to web resources. because it doesn't
        require cookies, session identifiers, or login pages; rather, it uses standard
        fields in the HTTP header.
        Note that, Basic Authentication is not encrypted channel and also easy to retrieve
        credentials as they are sent in plain text format.

config EXAMPLE_BASIC_AUTH_USERNAME
    string "Basic Authenticate User Name"
    depends on EXAMPLE_BASIC_AUTH
    default "ESP32"
    help
        The client's user name which used for basic authenticate.

config EXAMPLE_BASIC_AUTH_PASSWORD
    string "Basic Authenticate Password"
    depends on EXAMPLE_BASIC_AUTH
    default "ESP32Webserver"
    help
        The client's password which used for basic authenticate.

endmenu
```
